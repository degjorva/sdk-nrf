## CMakeLists.txt
```
#
# Copyright (c) 2026 Nordic Semiconductor ASA
#
# SPDX-License-Identifier: LicenseRef-Nordic-5-Clause
#

cmake_minimum_required(VERSION 3.20.0)

find_package(Zephyr REQUIRED HINTS $ENV{ZEPHYR_BASE})

project(ecdh_x25519_simple)

target_sources(app PRIVATE src/main.c)
```

## sample.yaml
```
sample:
  description: |
    Reproduces the ZigBee zb_osif_scalarmult() call pattern (X25519 ECDH via
    PSA_ECC_FAMILY_MONTGOMERY + psa_raw_key_agreement) using RFC 7748 §6.1
    known test vectors.  Used to debug CONFIG_CRACEN_ECC_COUNTERMEASURES on
    cracen-lite devices.
  name: X25519 ECDH sample (ZigBee reproduction)
tests:
  sample.ecdh_x25519.cracen:
    sysbuild: true
    tags:
      - psa
      - cracen
      - sysbuild
      - x25519
    platform_allow:
      - nrf54l15dk/nrf54l15/cpuapp
      - nrf54lm20dk/nrf54lm20a/cpuapp
      - nrf54lm20dk/nrf54lm20b/cpuapp
      - nrf54lv10dk/nrf54lv10a/cpuapp
      - nrf7120dk/nrf7120/cpuapp
    harness: console
    harness_config:
      type: multi_line
      regex:
        - ".*Example finished successfully!.*"
    integration_platforms:
      - nrf54l15dk/nrf54l15/cpuapp
      - nrf7120dk/nrf7120/cpuapp
```

## prj.conf
```kconfig
#
# Copyright (c) 2026 Nordic Semiconductor ASA
#
# SPDX-License-Identifier: LicenseRef-Nordic-5-Clause
#

CONFIG_MAIN_STACK_SIZE=4096
CONFIG_HEAP_MEM_POOL_SIZE=4096

CONFIG_LOG=y

CONFIG_NRF_SECURITY=y
CONFIG_MBEDTLS_PSA_CRYPTO_C=y

CONFIG_PSA_WANT_ALG_ECDH=y
CONFIG_PSA_WANT_KEY_TYPE_ECC_KEY_PAIR_IMPORT=y
CONFIG_PSA_WANT_ECC_MONTGOMERY_255=y
```

## boards/nrf54l15dk_nrf54l15_cpuapp.conf
```kconfig
#
# Copyright (c) 2026 Nordic Semiconductor ASA
#
# SPDX-License-Identifier: LicenseRef-Nordic-5-Clause
#
# nRF54L15 is the known-good reference - not affected by the cracen-lite bug.
CONFIG_PSA_CRYPTO_DRIVER_OBERON=n
CONFIG_PSA_CRYPTO_DRIVER_CRACEN=y

CONFIG_MBEDTLS_ENABLE_HEAP=y
CONFIG_MBEDTLS_HEAP_SIZE=8192

CONFIG_CRACEN_ECC_COUNTERMEASURES=y
```

## boards/nrf54lm20dk_nrf54lm20b_cpuapp.conf
```kconfig
#
# Copyright (c) 2026 Nordic Semiconductor ASA
#
# SPDX-License-Identifier: LicenseRef-Nordic-5-Clause
#

CONFIG_PSA_CRYPTO_DRIVER_OBERON=n
CONFIG_PSA_CRYPTO_DRIVER_CRACEN=y

CONFIG_MBEDTLS_ENABLE_HEAP=y
CONFIG_MBEDTLS_HEAP_SIZE=8192

# CONFIG_CRACEN_ECC_COUNTERMEASURES=n
```

## boards/nrf7120dk_nrf7120_cpuapp.conf
```kconfig
#
# Copyright (c) 2026 Nordic Semiconductor ASA
#
# SPDX-License-Identifier: LicenseRef-Nordic-5-Clause
#

CONFIG_PSA_CRYPTO_DRIVER_OBERON=n
CONFIG_PSA_CRYPTO_DRIVER_CRACEN=y

CONFIG_MBEDTLS_ENABLE_HEAP=y
CONFIG_MBEDTLS_HEAP_SIZE=8192

CONFIG_CRACEN_ECC_COUNTERMEASURES=y
```

## src/main.c
```c
/*
 * Copyright (c) 2026 Nordic Semiconductor ASA
 *
 * SPDX-License-Identifier: LicenseRef-Nordic-5-Clause
 */

#include <string.h>
#include <zephyr/logging/log.h>
#include <psa/crypto.h>

LOG_MODULE_REGISTER(ecdh_x25519, LOG_LEVEL_INF);

#define KEY_SIZE 32

static const uint8_t alice_private[KEY_SIZE] = {
	0x77, 0x07, 0x6d, 0x0a, 0x73, 0x18, 0xa5, 0x7d,
	0x3c, 0x16, 0xc1, 0x72, 0x51, 0xb2, 0x66, 0x45,
	0xdf, 0x4c, 0x2f, 0x87, 0xeb, 0xc0, 0x99, 0x2a,
	0xb1, 0x77, 0xfb, 0xa5, 0x1d, 0xb9, 0x2c, 0x2a,
};
static const uint8_t alice_public[KEY_SIZE] = {
	0x85, 0x20, 0xf0, 0x09, 0x89, 0x30, 0xa7, 0x54,
	0x74, 0x8b, 0x7d, 0xdc, 0xb4, 0x3e, 0xf7, 0x5a,
	0x0d, 0xbf, 0x3a, 0x0d, 0x26, 0x38, 0x1a, 0xf4,
	0xeb, 0xa4, 0xa9, 0x8e, 0xaa, 0x9b, 0x4e, 0x6a,
};
static const uint8_t bob_private[KEY_SIZE] = {
	0x5d, 0xab, 0x08, 0x7e, 0x62, 0x4a, 0x8a, 0x4b,
	0x79, 0xe1, 0x7f, 0x8b, 0x83, 0x80, 0x0e, 0xe6,
	0x6f, 0x3b, 0xb1, 0x29, 0x26, 0x18, 0xb6, 0xfd,
	0x1c, 0x2f, 0x8b, 0x27, 0xff, 0x88, 0xe0, 0xeb,
};
static const uint8_t bob_public[KEY_SIZE] = {
	0xde, 0x9e, 0xdb, 0x7d, 0x7b, 0x7d, 0xc1, 0xb4,
	0xd3, 0x5b, 0x61, 0xc2, 0xec, 0xe4, 0x35, 0x37,
	0x3f, 0x83, 0x43, 0xc8, 0x5b, 0x78, 0x67, 0x4d,
	0xad, 0xfc, 0x7e, 0x14, 0x6f, 0x88, 0x2b, 0x4f,
};
static const uint8_t expected_secret[KEY_SIZE] = {
	0x4a, 0x5d, 0x9d, 0x5b, 0xa4, 0xce, 0x2d, 0xe1,
	0x72, 0x8e, 0x3b, 0xf4, 0x80, 0x35, 0x0f, 0x25,
	0xe0, 0x7e, 0x21, 0xc9, 0x47, 0xd1, 0x9e, 0x33,
	0x76, 0xf0, 0x9b, 0x3c, 0x1e, 0x16, 0x17, 0x42,
};

static psa_status_t zb_osif_scalarmult(uint8_t *result_point, const uint8_t *scalar,
				       const uint8_t *point)
{
	psa_status_t status;
	mbedtls_svc_key_id_t key_id;
	size_t output_length;

	psa_key_attributes_t key_attributes = PSA_KEY_ATTRIBUTES_INIT;

	psa_set_key_usage_flags(&key_attributes, PSA_KEY_USAGE_DERIVE);
	psa_set_key_lifetime(&key_attributes, PSA_KEY_LIFETIME_VOLATILE);
	psa_set_key_algorithm(&key_attributes, PSA_ALG_ECDH);
	psa_set_key_type(&key_attributes, PSA_KEY_TYPE_ECC_KEY_PAIR(PSA_ECC_FAMILY_MONTGOMERY));

	status = psa_import_key(&key_attributes, scalar, KEY_SIZE, &key_id);
	if (status != PSA_SUCCESS) {
		return status;
	}

	psa_reset_key_attributes(&key_attributes);

	status = psa_raw_key_agreement(PSA_ALG_ECDH, key_id, point, KEY_SIZE,
				       result_point, KEY_SIZE, &output_length);

	psa_destroy_key(key_id);
	printk("status: %d\n", status);
	return status;
}

int main(void)
{
	uint8_t alice_secret[KEY_SIZE];
	uint8_t bob_secret[KEY_SIZE];
	int pass = 1;

	psa_crypto_init();

	zb_osif_scalarmult(alice_secret, alice_private, bob_public);
	zb_osif_scalarmult(bob_secret, bob_private, alice_public);

	if (memcmp(alice_secret, expected_secret, KEY_SIZE) != 0) {
		LOG_ERR("FAIL: Alice secret does not match expected");
		pass = 0;
	}
	if (memcmp(bob_secret, expected_secret, KEY_SIZE) != 0) {
		LOG_ERR("FAIL: Bob secret does not match expected");
		pass = 0;
	}
	if (memcmp(alice_secret, bob_secret, KEY_SIZE) != 0) {
		LOG_ERR("FAIL: Alice and Bob secrets do not match each other");
		pass = 0;
	}

	if (pass) {
		LOG_INF("PASS");
	}

	return 0;
}
```
