## samples/crypto/persistent_key_usage/boards/nrf54l15dk_nrf54l15_cpuapp_ns.conf
```kconfig
# Copyright (c) 2024 Nordic Semiconductor ASA
# SPDX-License-Identifier: LicenseRef-Nordic-5-Clause

# Use our upstream configuration flag to disable MbedTLS dependency
CONFIG_TFM_CRYPTO_USES_MBEDTLS=n

# Since we're not using ITS with CRACEN, no need for ITS encryption
# CONFIG_TFM_ITS_ENCRYPTED is not needed when ITS is disabled

# Disable key derivation module when not using MbedTLS to avoid algorithm conflicts
CONFIG_TFM_CRYPTO_KEY_DERIVATION_MODULE_ENABLED=n

# For nRF54L: Use CRACEN with KMU for hardware key storage instead of software ITS
CONFIG_PSA_CRYPTO_DRIVER_CRACEN=y

# Disable PSA crypto storage to use KMU hardware storage instead
CONFIG_MBEDTLS_PSA_CRYPTO_STORAGE_C=n
```

## samples/tfm/tfm_psa_template/Kconfig.sysbuild
```kconfig
#
# Copyright (c) 2024 Nordic Semiconductor
#
# SPDX-License-Identifier: LicenseRef-Nordic-5-Clause
#

config PARTITION_MANAGER
	default n

if SOC_SERIES_NRF54L

# nRF54L signs MCUboot with Ed25519 over the full image rather than its hash
# (Pure mode).
config BOOT_SIGNATURE_TYPE_PURE
	default y

# Generate keyfile.json so that "west flash --recover" provisions the NSIB
# Ed25519 public key to CRACEN KMU. Without this, b0 fails validation (-102).
config SECURE_BOOT_GENERATE_DEFAULT_KMU_KEYFILE
	default y if SECURE_BOOT_APPCORE

# Sample development key. Replace for production use.
config SECURE_BOOT_SIGNING_KEY_FILE
	default "../common/keys/nrf54l_nsib_sample_private.pem"

# Placeholder PSA certificate reference. nRF54L does not have a real
# PSA-certified value yet, and Kconfig.tfm only auto-defaults the string for
# nRF9160 and nRF5340. Replace for production use.
config TFM_PSA_CERTIFICATE_REFERENCE_VALUE
	default "0000000000000-00000"

endif

if BOARD_NRF5340DK_NRF5340_CPUAPP_NS

choice NETCORE
	default NETCORE_EMPTY
endchoice

config SECURE_BOOT_NETCORE
	default y

config NETCORE_APP_UPDATE
	default y

config MCUBOOT_APP_SYNC_UPDATEABLE_IMAGES
	default y

config MCUBOOT_USE_ALL_AVAILABLE_RAM
	default y

endif

source "share/sysbuild/Kconfig"
```

## samples/tfm/tfm_psa_template/sysbuild/mcuboot/boards/nrf5340dk_nrf5340_cpuapp.conf
```kconfig
#
# Copyright (c) 2024 Nordic Semiconductor ASA
#
# SPDX-License-Identifier: LicenseRef-Nordic-5-Clause
#

# In DTS builds BOOT_MAX_IMG_SECTORS_AUTO defaults to y (see
# bootloader/mcuboot/boot/zephyr/Kconfig:888 "default y if !PARTITION_MANAGER_ENABLED"),
# so BOOT_MAX_IMG_SECTORS is computed automatically from the DTS partition layout and
# cannot be set here.

CONFIG_PCD_READ_NETCORE_APP_VERSION=y
```

## tests/crypto/cracen_ml_dsa_verify/testcase.yaml
```yaml
tests:
  crypto.cracen_ml_dsa_verify:
    sysbuild: true
    platform_allow:
      - nrf54l15dk/nrf54l15/cpuapp
      - nrf54lm20dk/nrf54lm20a/cpuapp
      - nrf54lm20dk/nrf54lm20b/cpuapp
    integration_platforms:
      - nrf54lm20dk/nrf54lm20a/cpuapp
    tags:
      - crypto
      - cracen
      - ml_dsa
      - pqc
      - sysbuild
```

## tests/crypto/cracen_xof/testcase.yaml
```yaml
tests:
  crypto.cracen_xof:
    sysbuild: true
    platform_allow:
      - nrf54l15dk/nrf54l15/cpuapp
      - nrf54lm20dk/nrf54lm20a/cpuapp
      - nrf54lm20dk/nrf54lm20b/cpuapp
    integration_platforms:
      - nrf54l15dk/nrf54l15/cpuapp
    tags:
      - crypto
      - cracen
      - sysbuild
```
