## CMakeLists.txt
```
#
# Copyright (c) 2025 Nordic Semiconductor ASA
#
# SPDX-License-Identifier: LicenseRef-Nordic-5-Clause
#

cmake_minimum_required(VERSION 3.20.0)

find_package(Zephyr REQUIRED HINTS $ENV{ZEPHYR_BASE})

project(manufacturing_application)

# Generate C headers from PEM key files and binary verification message files
# in the keys/ directory. The generated header is placed in
# ${CMAKE_BINARY_DIR}/generated/provisioned_keys.h
include(cmake/keys.cmake)

# NORDIC SDK APP START
target_sources(app PRIVATE
  src/main.c
  src/recovery.c
  src/lcs.c
  src/ikg_check.c
  src/image_validation.c
  src/key_provisioning.c
  src/erase_protection.c
  src/huk_provisioning.c
  src/product_tests.c
  src/asset_provisioning.c
)
# NORDIC SDK APP END

target_include_directories(app PRIVATE
  # TF-M NS API headers (psa/crypto.h, psa/lifecycle.h, etc.)
  $<TARGET_PROPERTY:tfm,TFM_BINARY_DIR>/api_ns/interface/include
  # Application source directory (for mfg_log.h, step headers)
  ${CMAKE_CURRENT_SOURCE_DIR}/src
  # Build-time generated headers (provisioned_keys.h, image_digests.h)
  ${CMAKE_BINARY_DIR}/generated
)
```

## Kconfig
```
#
# Copyright (c) 2025 Nordic Semiconductor ASA
#
# SPDX-License-Identifier: LicenseRef-Nordic-5-Clause
#

config BLOCK_ERASE_ALL
	bool "Block erase-all by programming UICR.ERASEPROTECT during manufacturing"
	default n
	help
	  When enabled, the manufacturing application programs
	  UICR.ERASEPROTECT.PROTECT0 and UICR.ERASEPROTECT.PROTECT1 to
	  0x50FA50FA, permanently blocking the SWD erase-all command on the
	  device.

	  WARNING: This operation is irreversible without authenticated erase-all.
	  Do not enable this option for engineering/development devices.

	  NOTE: Writing UICR requires Secure-mode access. From a TF-M non-secure
	  application this is performed via the TF-M platform service. See
	  src/erase_protection.c for integration details.

config MFG_APP_KEY_KMU_SLOT
	int "KMU slot holding the manufacturing application authentication key"
	default 122
	help
	  KMU slot number that holds the key used to authenticate this
	  manufacturing application. This key is revoked in Step 12 of the
	  manufacturing flow once provisioning is complete.

	  The key must be pre-loaded into this slot before the manufacturing
	  application runs (e.g. by BL1 or BL2).

config MFG_UROT_KEY_GEN0_KMU_SLOT
	int "KMU slot for UROT public key generation 0 (urot_pubkey_gen0)"
	default 120
	help
	  First physical KMU slot for the UROT generation-0 public key.
	  Ed25519 keys occupy 2 consecutive slots.

config MFG_UROT_KEY_GEN1_KMU_SLOT
	int "KMU slot for UROT public key generation 1 (urot_pubkey_gen1)"
	default 124
	help
	  First physical KMU slot for the UROT generation-1 public key.
	  Ed25519 keys occupy 2 consecutive slots.

source "Kconfig.zephyr"
```

## sample.yaml
```
sample:
  description: TF-M Manufacturing Application reference for nRF54LV10A
  name: TF-M Manufacturing Application
common:
  tags:
    - tfm
    - manufacturing
  platform_allow:
    - nrf54lv10dk/nrf54lv10a/cpuapp/ns
  integration_platforms:
    - nrf54lv10dk/nrf54lv10a/cpuapp/ns
tests:
  sample.tfm.manufacturing_application:
    sysbuild: true
    tags:
      - ci_build
      - sysbuild
    build_only: true
```

## sysbuild.conf
```
#
# Copyright (c) 2025 Nordic Semiconductor ASA
#
# SPDX-License-Identifier: LicenseRef-Nordic-5-Clause
#

SB_CONFIG_BOOTLOADER_MCUBOOT=y
SB_CONFIG_SECURE_BOOT_APPCORE=y
SB_CONFIG_BOOT_SIGNATURE_TYPE_ECDSA_P256=y
SB_CONFIG_MCUBOOT_MODE_OVERWRITE_ONLY=y
```

## prj.conf
```kconfig
#
# Copyright (c) 2025 Nordic Semiconductor ASA
#
# SPDX-License-Identifier: LicenseRef-Nordic-5-Clause
#

# TF-M integration
CONFIG_TFM_PARTITION_PLATFORM=y
CONFIG_TFM_PARTITION_INITIAL_ATTESTATION=y
CONFIG_TFM_NRF_PROVISIONING=y

# PSA Crypto algorithms and key types needed by the manufacturing flow
CONFIG_PSA_WANT_ALG_SHA_256=y
CONFIG_PSA_WANT_ALG_ECDSA=y
CONFIG_PSA_WANT_ALG_PURE_EDDSA=y
CONFIG_PSA_WANT_KEY_TYPE_ECC_PUBLIC_KEY=y
CONFIG_PSA_WANT_ECC_TWISTED_EDWARDS_255=y
CONFIG_PSA_WANT_ECC_SECP_R1_256=y
CONFIG_PSA_WANT_GENERATE_RANDOM=y

# TF-M logging (set to silence for cleaner manufacturing output; enable for debugging)
CONFIG_TFM_LOG_LEVEL_SILENCE=y

# Zephyr logging (used for debug-level internal traces; manufacturing output uses printk)
CONFIG_LOG=y
CONFIG_LOG_MODE_IMMEDIATE=y

# MCUboot: manufacturing app must be built as an MCUboot-compatible image
CONFIG_BOOTLOADER_MCUBOOT=y

# Flash access (needed to read flash regions for image validation)
CONFIG_FLASH=y
CONFIG_FLASH_MAP=y

# Stack size: increased to accommodate PSA crypto operations and TF-M IPC
CONFIG_MAIN_STACK_SIZE=4096
CONFIG_SYSTEM_WORKQUEUE_STACK_SIZE=2048

# Reboot support (used in step 12)
CONFIG_REBOOT=y
```

## boards/nrf54lv10dk_nrf54lv10a_cpuapp_ns.conf
```kconfig
#
# Copyright (c) 2025 Nordic Semiconductor ASA
#
# SPDX-License-Identifier: LicenseRef-Nordic-5-Clause
#

# nRF54LV10A uses RRAMC (Resistive RAM Controller) instead of NVMC
CONFIG_NRFX_RRAMC=y
```

## src/main.c
```c
/*
 * Copyright (c) 2025 Nordic Semiconductor ASA
 *
 * SPDX-License-Identifier: LicenseRef-Nordic-5-Clause
 */

/**
 * @file main.c
 *
 * Manufacturing application — 12-step provisioning flow for nRF54LV10A.
 *
 * Overview
 * --------
 * This application is a reference implementation of the manufacturing flow
 * for Nordic Semiconductor devices using TF-M and CRACEN. It runs as a TF-M
 * non-secure application in the MCUboot slot0_ns partition after the full
 * boot chain (BL1 → BL2/MCUboot → TF-M) has completed.
 *
 * Idempotency
 * -----------
 * The application is designed to be idempotent: every boot executes all
 * 12 steps. Each step checks its own precondition at entry and exits cleanly
 * if the operation has already been performed (e.g. "already provisioned").
 * This makes the application immune to power drops at any point in the flow.
 *
 * Execution flow
 * --------------
 * Step  1: Show LCS at entry — verifies device is in a valid manufacturing state.
 * Step  2: Validate no IKG seed present (in 'Manufacturing and Test' only).
 * Step  3: Validate digests of all sub-images (BL1, BL2, mfg app, app candidate).
 * Step  4: Provision and verify secure-boot and ADAC public keys.
 * Step  5: Block erase-all via UICR.ERASEPROTECT (if CONFIG_BLOCK_ERASE_ALL).
 * Step  6: Advance LCS to 'PROT Provisioning'.
 * Step  7: Provision KeyRAM random data (KMU slots 248, 249).
 * Step  8: Provision IKG seed; log IAK / MKEK / MEXT identifiers.
 * Step  9: End product tests (placeholder — customise for your product).
 * Step 10: Provision remaining assets and device enrolment (placeholder).
 * Step 11: Advance LCS to 'Secured'.
 * Step 12: Revoke manufacturing app key; reboot to install target application.
 *
 * Open questions and stubs
 * ------------------------
 * Several operations require Secure-mode access and are currently implemented
 * as stubs pending the addition of TF-M platform services:
 *   - LCS advancement (steps 6 and 11)
 *   - UICR.ERASEPROTECT read/write (step 5)
 *   - KeyRAM random provisioning (step 7)
 *   - IKG seed provisioning via hw_unique_key_write_random (step 8)
 *   - Image hashing for Secure-side images (step 3)
 *
 * See each step's .c file for TODO comments with detailed integration guidance.
 * A full list of open questions is provided in README.rst.
 *
 * Reference
 * ---------
 * See README.rst for build instructions, key generation, and expected output.
 */

#include <zephyr/kernel.h>
#include <zephyr/sys/reboot.h>
#include <psa/crypto.h>
#include <psa/lifecycle.h>

#ifdef CONFIG_BUILD_WITH_TFM
#include <tfm_ns_interface.h>
#endif

#include "mfg_log.h"
#include "lcs.h"
#include "ikg_check.h"
#include "image_validation.h"
#include "key_provisioning.h"
#include "erase_protection.h"
#include "huk_provisioning.h"
#include "product_tests.h"
#include "asset_provisioning.h"

int main(void)
{
	psa_status_t status;

	status = psa_crypto_init();
	if (status != PSA_SUCCESS) {
		MFG_LOG_ERR("FATAL: psa_crypto_init() failed (%d). "
			    "Cannot continue.\n", status);
		return 0;
	}

	/* ------------------------------------------------------------------ */
	/* Step 1 — Show LCS at entry                                          */
	/* ------------------------------------------------------------------ */
	uint32_t lcs_state = lcs_step1_show();

	/* ------------------------------------------------------------------ */
	/* Step 2 — Validate no IKG seed or KeyRAM random in MTEST LCS        */
	/* Only executed when the device is in 'Manufacturing and Test'.       */
	/* In 'PROT Provisioning' the seed may already be present from a      */
	/* previous (partial) run; Step 2 is skipped to remain idempotent.    */
	/* ------------------------------------------------------------------ */
	if ((lcs_state & PSA_LIFECYCLE_PSA_STATE_MASK) == PSA_LIFECYCLE_ASSEMBLY_AND_TEST) {
		ikg_step2_check_empty();
	}

	/* ------------------------------------------------------------------ */
	/* Step 3 — Check consistency of all images                           */
	/* ------------------------------------------------------------------ */
	image_step3_validate_all();

	/* ------------------------------------------------------------------ */
	/* Step 4 — Provision secure-boot and ADAC keys                       */
	/* ------------------------------------------------------------------ */
	key_step4_provision_all();

	/* ------------------------------------------------------------------ */
	/* Step 5 — Block erase-all (if CONFIG_BLOCK_ERASE_ALL is enabled)    */
	/* ------------------------------------------------------------------ */
	erase_step5_block_if_needed();

	/* ------------------------------------------------------------------ */
	/* Step 6 — Advance LCS to 'PROT Provisioning'                        */
	/* ------------------------------------------------------------------ */
	lcs_step6_advance_to_prot_provisioning();

	/* ------------------------------------------------------------------ */
	/* Step 7 — Provision KeyRAM random data                               */
	/* ------------------------------------------------------------------ */
	huk_step7_provision_keyram_random();

	/* ------------------------------------------------------------------ */
	/* Step 8 — Provision IKG seed                                         */
	/* ------------------------------------------------------------------ */
	huk_step8_provision_ikg_seed();

	/* ------------------------------------------------------------------ */
	/* Step 9 — End product tests                                          */
	/* ------------------------------------------------------------------ */
	tests_step9_run();

	/* ------------------------------------------------------------------ */
	/* Step 10 — Provision remaining assets and device enrolment          */
	/* ------------------------------------------------------------------ */
	assets_step10_provision();

	/* ------------------------------------------------------------------ */
	/* Step 11 — Advance LCS to 'Secured'                                  */
	/* ------------------------------------------------------------------ */
	lcs_step11_advance_to_secured();

	/* ------------------------------------------------------------------ */
	/* Step 12 — Clean up and goodbye                                      */
	/* ------------------------------------------------------------------ */
	MFG_LOG_STEP("Cleaning up");

	key_step12_revoke_mfg_key();

	MFG_LOG_INF("\nManufacturing process is completed. Now the device is about to reboot and\n");
	MFG_LOG_INF("target application will be installed.\n");
	MFG_LOG_INF("\nRebooting the device...\n");

	/* Allow the UART to flush the final log messages before reboot. */
	k_sleep(K_MSEC(100));

	sys_reboot(SYS_REBOOT_COLD);

	return 0;
}
```

## src/asset_provisioning.c
```c
/*
 * Copyright (c) 2025 Nordic Semiconductor ASA
 *
 * SPDX-License-Identifier: LicenseRef-Nordic-5-Clause
 */

/**
 * Step 10 — Provision remaining assets and device enrolment (placeholder).
 *
 * At this stage of the manufacturing flow the device is:
 *   - Authenticated (ADAC / secure-boot keys provisioned, Step 4)
 *   - Running with IKG seed and IAK available (Step 8)
 *   - In LCS = 'PROT Provisioning' (Step 6)
 *
 * This makes it safe to:
 *   - Establish a trusted, authenticated secure channel to an external
 *     Device Management or provisioning server (using the IAK for mutual
 *     authentication).
 *   - Enrol the device in a cloud Device Management System (DMS).
 *   - Negotiate or receive additional assets:
 *       * X.509 device certificates
 *       * Symmetric keys for application-level encryption
 *       * Firmware update keys
 *       * Network credentials
 *
 * Security note:
 *   Secure delivery or derivation of private keys and symmetric keys,
 *   while technically feasible using the MKEK/MEXT derivation chain,
 *   is out of scope of this reference application.
 */

#include "asset_provisioning.h"
#include "mfg_log.h"

void assets_step10_provision(void)
{
	MFG_LOG_STEP("Provisioning of remaining assets");

	MFG_LOG_INF("This is a good place to add code for provisioning of other assets.\n");
	MFG_LOG_INF("Manufacturing app is authenticated at that stage, so it is possible to\n");
	MFG_LOG_INF("establish a trusted secure channel to an external system, to enrol the\n");
	MFG_LOG_INF("device to Device Management System, and get/negotiate any other required\n");
	MFG_LOG_INF("assets (i.e. certificates, keys etc.)\n\n");
	MFG_LOG_INF("Secure delivery/derivation of private/symmetric keys, however feasible,\n");
	MFG_LOG_INF("is out of scope of this application.\n");
}
```

## src/asset_provisioning.h
```c
/*
 * Copyright (c) 2025 Nordic Semiconductor ASA
 *
 * SPDX-License-Identifier: LicenseRef-Nordic-5-Clause
 */

/**
 * @file asset_provisioning.h
 *
 * Step 10 — Provision remaining assets and enrol the device.
 *
 * This is a placeholder for product-specific provisioning beyond what the
 * mandatory manufacturing flow covers.
 */

#ifndef ASSET_PROVISIONING_H_
#define ASSET_PROVISIONING_H_

/**
 * @brief Step 10 — Provision remaining assets and enrol the device.
 *
 * Placeholder implementation. Extend this function with any additional
 * provisioning required by your product.
 */
void assets_step10_provision(void);

#endif /* ASSET_PROVISIONING_H_ */
```

## src/erase_protection.c
```c
/*
 * Copyright (c) 2025 Nordic Semiconductor ASA
 *
 * SPDX-License-Identifier: LicenseRef-Nordic-5-Clause
 */

/**
 * Step 5 — Block erase-all via UICR.ERASEPROTECT.
 *
 * Hardware background (nRF54LV10A):
 *   UICR.ERASEPROTECT register pair (Secure address space only):
 *     NRF_UICR_S->ERASEPROTECT[0].PROTECT0  @ 0xFFD060  (reset: 0xFFFFFFFF)
 *     NRF_UICR_S->ERASEPROTECT[0].PROTECT1  @ 0xFFD07C  (reset: 0xFFFFFFFF)
 *
 *   Valid states:
 *     0xFFFFFFFF / 0xFFFFFFFF — protection NOT active (erase-all allowed)
 *     0x50FA50FA / 0x50FA50FA — protection active (erase-all blocked)
 *
 *   Any other value is suspicious and logged as an error.
 *
 * Limitation — NS world cannot access UICR:
 *   UICR is mapped only in the Secure address space (0xFFD000).
 *   A TF-M non-secure application cannot read or write UICR directly.
 *
 *   TODO: Implement a TF-M platform service (or extend an existing one) that:
 *     1. Reads UICR.ERASEPROTECT.PROTECT0/PROTECT1 and returns them to NS.
 *     2. When activated, writes 0x50FA50FA to both registers.
 *
 *   Prototype for the Secure-side service functions:
 *
 *     int platform_svc_eraseprotect_read(uint32_t *protect0, uint32_t *protect1);
 *     int platform_svc_eraseprotect_activate(void);
 *
 *   On the Secure side, the write uses nrfx_rramc_otp_word_write() or direct
 *   MMIO, similar to how bl_storage writes OTP fields.
 *
 * Runtime TAMPC protection:
 *   In addition to the UICR OTP register, the TAMPC peripheral has a
 *   PROTECT.ERASEPROTECT.CTRL register that can assert protection at runtime:
 *     NRF_TAMPC->PROTECT.ERASEPROTECT.CTRL =
 *         (TAMPC_PROTECT_ERASEPROTECT_CTRL_KEY_KEY << 16) |
 *         (TAMPC_PROTECT_ERASEPROTECT_CTRL_VALUE_High);
 *   This is also Secure-only. If UICR programming is not an option, runtime
 *   TAMPC protection is an alternative. Document which mechanism you intend
 *   to use in your product.
 */

#include "erase_protection.h"
#include "mfg_log.h"
#include "recovery.h"

#include <autoconf.h>

#define ERASEPROTECT_ACTIVE_VALUE   0x50FA50FAU
#define ERASEPROTECT_INACTIVE_VALUE 0xFFFFFFFFU

/* ---------------------------------------------------------------------------
 * Stub for Secure-side UICR read.
 * Replace with a real TF-M platform service call.
 * ---------------------------------------------------------------------------
 */
static int platform_svc_eraseprotect_read(uint32_t *protect0, uint32_t *protect1)
{
	/*
	 * TODO: Implement a TF-M platform IPC call that reads:
	 *   NRF_UICR_S->ERASEPROTECT[0].PROTECT0
	 *   NRF_UICR_S->ERASEPROTECT[0].PROTECT1
	 * and returns them to the NS caller.
	 */
	*protect0 = ERASEPROTECT_INACTIVE_VALUE; /* stub: assume inactive */
	*protect1 = ERASEPROTECT_INACTIVE_VALUE;
	return -ENOSYS; /* -ENOSYS indicates stub — not yet implemented */
}

/* ---------------------------------------------------------------------------
 * Stub for Secure-side UICR write.
 * Replace with a real TF-M platform service call.
 * ---------------------------------------------------------------------------
 */
static int platform_svc_eraseprotect_activate(void)
{
	/*
	 * TODO: Implement a TF-M platform IPC call that writes:
	 *   NRF_UICR_S->ERASEPROTECT[0].PROTECT0 = 0x50FA50FA
	 *   NRF_UICR_S->ERASEPROTECT[0].PROTECT1 = 0x50FA50FA
	 *
	 * On the Secure side this is a one-time OTP write (RRAMC word write).
	 * The write must be verified by reading back the values.
	 */
	return -ENOSYS;
}

/* ---------------------------------------------------------------------------
 * Step 5 entry point
 * ---------------------------------------------------------------------------
 */
void erase_step5_block_if_needed(void)
{
	MFG_LOG_STEP("Checking erase-all policy");

#ifdef CONFIG_BLOCK_ERASE_ALL
	MFG_LOG_INF("CONFIG_BLOCK_ERASE_ALL is active\n");
#else
	MFG_LOG_INF("CONFIG_BLOCK_ERASE_ALL is not active\n");
#endif

	uint32_t protect0 = 0;
	uint32_t protect1 = 0;
	int err = platform_svc_eraseprotect_read(&protect0, &protect1);

	if (err == -ENOSYS) {
		MFG_LOG_INF("UICR.ERASEPROTECT.PROTECT0 = <unavailable from NS>\n");
		MFG_LOG_INF("UICR.ERASEPROTECT.PROTECT1 = <unavailable from NS>\n");
		MFG_LOG_INF("[STUB] UICR read not yet implemented — platform service needed.\n");
		MFG_LOG_INF("       See src/erase_protection.c for integration details.\n");
		return;
	}

	if (err != 0) {
		MFG_LOG_ERR("Failed to read UICR.ERASEPROTECT (err=%d).\n", err);
		recovery_suspend(false);
	}

	MFG_LOG_INF("UICR.ERASEPROTECT.PROTECT0 = 0x%08X\n", protect0);
	MFG_LOG_INF("UICR.ERASEPROTECT.PROTECT1 = 0x%08X\n", protect1);

	bool p0_active   = (protect0 == ERASEPROTECT_ACTIVE_VALUE);
	bool p1_active   = (protect1 == ERASEPROTECT_ACTIVE_VALUE);
	bool p0_inactive = (protect0 == ERASEPROTECT_INACTIVE_VALUE);
	bool p1_inactive = (protect1 == ERASEPROTECT_INACTIVE_VALUE);
	bool p0_valid    = p0_active || p0_inactive;
	bool p1_valid    = p1_active || p1_inactive;

	/* ----- Suspicious values ----- */
	if (!p0_valid || !p1_valid) {
		MFG_LOG_ERR("\nThis is suspicious — UICR.ERASEPROTECT.PROTECT0 and "
			    "UICR.ERASEPROTECT.PROTECT1\n");
		MFG_LOG_ERR("shall be equal to 0xFFFFFFFF.\n");
		recovery_suspend(false);
	}

	bool currently_active = p0_active && p1_active;

#ifdef CONFIG_BLOCK_ERASE_ALL

	if (currently_active) {
		MFG_LOG_INF("erase-all is blocked in UICR, nothing to do.\n");
		return;
	}

	MFG_LOG_INF("\nBlocking erase-all...\n");

	err = platform_svc_eraseprotect_activate();
	if (err != 0) {
		MFG_LOG_ERR("Failed to activate ERASEPROTECT (err=%d).\n", err);
		recovery_suspend(false);
	}

	MFG_LOG_INF("Verifying erase-all...\n");

	err = platform_svc_eraseprotect_read(&protect0, &protect1);
	if (err != 0) {
		MFG_LOG_ERR("Failed to re-read UICR.ERASEPROTECT after write (err=%d).\n", err);
		recovery_suspend(false);
	}

	MFG_LOG_INF("UICR.ERASEPROTECT.PROTECT0 = 0x%08X\n", protect0);
	MFG_LOG_INF("UICR.ERASEPROTECT.PROTECT1 = 0x%08X\n", protect1);

	if (protect0 != ERASEPROTECT_ACTIVE_VALUE || protect1 != ERASEPROTECT_ACTIVE_VALUE) {
		MFG_LOG_ERR("\nSome failures occurred while updating the UICR content.\n");
		recovery_suspend(false);
	}

	MFG_LOG_INF("\nerase-all is successfully blocked in UICR.\n");

#else /* CONFIG_BLOCK_ERASE_ALL not set */

	if (!currently_active) {
		MFG_LOG_INF("erase-all is not blocked in UICR, nothing to do.\n");
		MFG_LOG_INF("\nNotice that the device is not protected against erase all.\n");
		MFG_LOG_INF("Anyone having access to SWD port would be able to wipe out RRAM content.\n");
		MFG_LOG_INF("It would be expected behaviour for engineering devices, but questionable "
			    "for end-devices.\n");
		MFG_LOG_INF("Checking manufacturing flow on engineering devices — "
			    "is it your intention?\n");
	} else {
		MFG_LOG_INF("erase-all is blocked in UICR.\n");
	}

#endif /* CONFIG_BLOCK_ERASE_ALL */
}
```

## src/erase_protection.h
```c
/*
 * Copyright (c) 2025 Nordic Semiconductor ASA
 *
 * SPDX-License-Identifier: LicenseRef-Nordic-5-Clause
 */

/**
 * @file erase_protection.h
 *
 * Step 5 — Check and optionally block the SWD erase-all command via
 * UICR.ERASEPROTECT on the nRF54LV10A.
 */

#ifndef ERASE_PROTECTION_H_
#define ERASE_PROTECTION_H_

/**
 * @brief Step 5 — Check and optionally block erase-all.
 *
 * Reads UICR.ERASEPROTECT.PROTECT0 and PROTECT1 and logs their content.
 * If CONFIG_BLOCK_ERASE_ALL is enabled and the protection is not yet active,
 * programs the protection values and verifies the write.
 *
 * @note UICR is a Secure-mode-only register. This function calls a TF-M
 *       platform service stub. See erase_protection.c for integration details.
 */
void erase_step5_block_if_needed(void);

#endif /* ERASE_PROTECTION_H_ */
```

## src/huk_provisioning.c
```c
/*
 * Copyright (c) 2025 Nordic Semiconductor ASA
 *
 * SPDX-License-Identifier: LicenseRef-Nordic-5-Clause
 */

/**
 * Steps 7 and 8 — KeyRAM random and IKG seed provisioning.
 *
 * These operations are performed after the LCS transition to PROT Provisioning
 * (Step 6) because provisioning the IKG seed and MKEK in 'Manufacturing and
 * Test' would be caught by Step 2 on the next reboot as a security error.
 *
 * From a TF-M non-secure application:
 *
 * KeyRAM random (slots 248, 249):
 *   cracen_provision_prot_ram_inv_slots() is a Secure-side driver function.
 *   From NS, generate the random data and import it via psa_import_key() with
 *   CRACEN_KMU_KEY_USAGE_SCHEME_PROTECTED and the respective slot IDs.
 *
 *   Alternatively, if TF-M exposes this as a platform service, call it via
 *   the IPC interface.
 *
 *   For simplicity in this reference, the provisioning is implemented as a
 *   PSA key generation operation targeting the KMU slots directly.
 *
 * IKG seed (hw_unique_key):
 *   hw_unique_key_write_random() is a Secure-side library function that
 *   writes a random 48-byte seed to the CRACEN IKG seed KMU slots.
 *   From NS, this must go through a TF-M platform service.
 *
 *   TODO: Expose hw_unique_key_write_random() as a TF-M platform IPC call.
 *   Until then, the step is implemented as a stub.
 *
 * Slot revocation note:
 *   A KMU slot that held a REVOKABLE key and was subsequently revoked will
 *   appear empty to psa_get_key_attributes() but psa_import_key() / the
 *   underlying cracen_kmu_provision() will fail. The "unknown cause / possible
 *   reason" log message is the best achievable diagnostic in this case.
 */

#include "huk_provisioning.h"
#include "mfg_log.h"
#include "recovery.h"

#include <zephyr/kernel.h>
#include <psa/crypto.h>
#include <cracen_psa_kmu.h>
#include <cracen_psa_key_ids.h>

/* ---------------------------------------------------------------------------
 * Check whether a KMU slot is occupied via PSA attribute query.
 * ---------------------------------------------------------------------------
 */
static bool kmu_slot_is_occupied(int slot_id, enum cracen_kmu_metadata_key_usage_scheme scheme)
{
	psa_key_id_t key_id = PSA_KEY_HANDLE_FROM_CRACEN_KMU_SLOT(scheme, slot_id);
	mbedtls_svc_key_id_t svc_id = mbedtls_svc_key_id_make(0, key_id);

	psa_key_attributes_t attr = PSA_KEY_ATTRIBUTES_INIT;
	psa_status_t status = psa_get_key_attributes(svc_id, &attr);

	psa_reset_key_attributes(&attr);
	return status == PSA_SUCCESS;
}

/* ---------------------------------------------------------------------------
 * Step 7 — Provision KeyRAM random data (protected RAM invalidation slots)
 * ---------------------------------------------------------------------------
 */
void huk_step7_provision_keyram_random(void)
{
	MFG_LOG_STEP("Provisioning of KeyRam Random");

	/*
	 * Check both slots. Since they are always provisioned together, checking
	 * slot 248 is sufficient; checking both is more defensive.
	 */
	bool slot1_ok = kmu_slot_is_occupied(PROTECTED_RAM_INVALIDATION_DATA_SLOT1,
					     CRACEN_KMU_KEY_USAGE_SCHEME_PROTECTED);
	bool slot2_ok = kmu_slot_is_occupied(PROTECTED_RAM_INVALIDATION_DATA_SLOT2,
					     CRACEN_KMU_KEY_USAGE_SCHEME_PROTECTED);

	if (slot1_ok && slot2_ok) {
		MFG_LOG_INF("KeyRam Random already provisioned.\n");
		return;
	}

	/*
	 * TODO: Call a TF-M platform service that wraps
	 * cracen_provision_prot_ram_inv_slots() on the Secure side.
	 *
	 * Pseudocode for the platform service:
	 *
	 *   psa_status_t cracen_provision_prot_ram_inv_slots();
	 *   // (Secure-side: generates random data and calls cracen_kmu_provision()
	 *   //  for slots 248 and 249 with CRACEN_KMU_KEY_USAGE_SCHEME_PROTECTED.)
	 *
	 * Alternative (direct PSA from NS — if TF-M proxy supports it):
	 *
	 *   uint8_t random_data[16];
	 *   for each slot (248, 249):
	 *     psa_generate_random(random_data, sizeof(random_data));
	 *     psa_key_attributes_t attr = PSA_KEY_ATTRIBUTES_INIT;
	 *     psa_set_key_id(&attr, mbedtls_svc_key_id_make(0,
	 *         PSA_KEY_HANDLE_FROM_CRACEN_KMU_SLOT(
	 *             CRACEN_KMU_KEY_USAGE_SCHEME_PROTECTED, slot)));
	 *     psa_set_key_lifetime(&attr, PSA_KEY_LIFETIME_FROM_PERSISTENCE_AND_LOCATION(
	 *         PSA_KEY_PERSISTENCE_DEFAULT, PSA_KEY_LOCATION_CRACEN_KMU));
	 *     psa_set_key_type(&attr, PSA_KEY_TYPE_AES);
	 *     psa_set_key_bits(&attr, 128);
	 *     psa_set_key_usage_flags(&attr, PSA_KEY_USAGE_ENCRYPT | PSA_KEY_USAGE_DECRYPT);
	 *     psa_set_key_algorithm(&attr, PSA_ALG_GCM);
	 *     mbedtls_svc_key_id_t out_id = MBEDTLS_SVC_KEY_ID_INIT;
	 *     psa_import_key(&attr, random_data, sizeof(random_data), &out_id);
	 */

	MFG_LOG_INF("Provisioning KeyRam Random to KMU, slot %d...",
		    PROTECTED_RAM_INVALIDATION_DATA_SLOT1);
	MFG_LOG_INF(" STUB (platform service not yet implemented)\n");
	MFG_LOG_INF("[STUB] In production, replace this stub with a TF-M platform service call.\n");

	/* Un-comment the block below after implementing the platform service:
	 *
	 * psa_status_t status = platform_svc_provision_prot_ram_inv_slots();
	 * if (status != PSA_SUCCESS) {
	 *     MFG_LOG_INF(" FAIL\n");
	 *     MFG_LOG_ERR("The cause is unknown. Possible reason — a key was provisioned\n");
	 *     MFG_LOG_ERR("and revoked from given KMU slot.\n");
	 *     recovery_suspend(true);
	 * }
	 * MFG_LOG_INF(" OK\n");
	 */
}

/* ---------------------------------------------------------------------------
 * Step 8 — Provision IKG seed and log derived key information
 * ---------------------------------------------------------------------------
 */
void huk_step8_provision_ikg_seed(void)
{
	MFG_LOG_STEP("Provisioning of IKG seed");

	/*
	 * Check IKG seed presence by attempting to export the IAK public key.
	 * psa_export_public_key() will succeed only if the IKG seed is present.
	 */
	uint8_t iak_pub[32];
	size_t  iak_pub_len = 0;

	mbedtls_svc_key_id_t iak_id =
		mbedtls_svc_key_id_make(0, CRACEN_BUILTIN_IDENTITY_KEY_ID);

	psa_status_t status = psa_export_public_key(iak_id,
						    iak_pub, sizeof(iak_pub),
						    &iak_pub_len);

	if (status == PSA_SUCCESS) {
		MFG_LOG_INF("IKG seed already provisioned.\n");
		/* Fall through to log derived key information. */
	} else {
		/*
		 * TODO: Call a TF-M platform service that wraps
		 * hw_unique_key_write_random() on the Secure side.
		 *
		 * hw_unique_key_write_random() generates a cryptographically
		 * random 48-byte (384-bit) value and writes it to the KMU
		 * IKG seed slots using CRACEN_KMU_KEY_USAGE_SCHEME_SEED.
		 * The CRACEN IKG then uses this seed to derive all device keys.
		 *
		 * Pseudocode:
		 *   int err = platform_svc_hw_unique_key_write_random();
		 *   if (err != HW_UNIQUE_KEY_SUCCESS) {
		 *       MFG_LOG_INF(" FAIL\n");
		 *       MFG_LOG_ERR("The cause is unknown. Possible reason — a key was "
		 *                   "provisioned and revoked from given KMU slot.\n");
		 *       recovery_suspend(true);
		 *   }
		 *   MFG_LOG_INF(" OK\n");
		 *
		 * After writing the seed, re-export the IAK public key:
		 *   status = psa_export_public_key(iak_id, iak_pub, sizeof(iak_pub), &iak_pub_len);
		 */

		MFG_LOG_INF("Provisioning IKG seed to KMU, slot %d...",
			    CONFIG_CRACEN_IKG_SEED_KMU_SLOT);
		MFG_LOG_INF(" STUB (platform service not yet implemented)\n");
		MFG_LOG_INF("[STUB] In production, replace this stub with a TF-M platform service.\n");
		return;
	}

	/* ----- Log derived key information ----- */
	MFG_LOG_INF("\nInitial Attestation Key (IAK, also known as Identity Key) "
		    "ID: 0x%08X\n", CRACEN_BUILTIN_IDENTITY_KEY_ID);
	MFG_LOG_INF("Public key: ");
	for (size_t i = 0; i < iak_pub_len; i++) {
		MFG_LOG_INF("%02x", iak_pub[i]);
		if (i == 3) {
			MFG_LOG_INF(" ... ");
		}
	}
	MFG_LOG_INF("\n\n");

	MFG_LOG_INF("Master Key Encryption Key (MKEK) ID: 0x%08X\n", CRACEN_BUILTIN_MKEK_ID);
	MFG_LOG_INF("Master External Key (MEXT) ID:       0x%08X\n", CRACEN_BUILTIN_MEXT_ID);

	/*
	 * PSA Instance ID is derived from the IAK public key.
	 * Format TBD — typically a hash of the public key.
	 *
	 * TODO: Compute PSA Instance ID per the PSA attestation specification:
	 *   uint8_t instance_id[33]; // 0x01 || SHA-256(pub_key)
	 *   instance_id[0] = 0x01;   // GUID type byte
	 *   psa_hash_compute(PSA_ALG_SHA_256, iak_pub, iak_pub_len,
	 *                    instance_id + 1, 32, &hash_len);
	 */
	MFG_LOG_INF("PSA Instance ID: <TBD — computed from IAK public key>\n");
}
```

## src/huk_provisioning.h
```c
/*
 * Copyright (c) 2025 Nordic Semiconductor ASA
 *
 * SPDX-License-Identifier: LicenseRef-Nordic-5-Clause
 */

/**
 * @file huk_provisioning.h
 *
 * Steps 7 and 8 — Provision KeyRAM random data and IKG seed.
 *
 * "KeyRAM random" refers to the protected RAM invalidation slots (KMU slots
 * 248 and 249, defined as PROTECTED_RAM_INVALIDATION_DATA_SLOT1/2 in
 * cracen_kmu.h). These hold random data that CRACEN pushes to its protected
 * RAM to overwrite key material after each use.
 *
 * "IKG seed" is the 384-bit (48-byte) seed for CRACEN's Internal Key
 * Generator. From the seed, CRACEN derives all device-unique keys:
 *   - Initial Attestation Key (IAK) — ID 0x7FFFC001
 *   - Master Key Encryption Key (MKEK) — ID 0x7FFFC002
 *   - Master External Key (MEXT) — ID 0x7FFFC003
 */

#ifndef HUK_PROVISIONING_H_
#define HUK_PROVISIONING_H_

/**
 * @brief Step 7 — Provision KeyRAM random data to KMU slots 248 and 249.
 *
 * If already provisioned, logs that fact and returns. Otherwise generates
 * random data and provisions both slots. Suspends on failure.
 */
void huk_step7_provision_keyram_random(void);

/**
 * @brief Step 8 — Provision the IKG seed and log derived key information.
 *
 * If already provisioned, logs that fact and returns. Otherwise generates
 * and provisions the 384-bit IKG seed. After provisioning, logs the public
 * representation of IAK, MKEK ID, MEXT ID, and PSA Instance ID.
 * Suspends on failure.
 */
void huk_step8_provision_ikg_seed(void);

#endif /* HUK_PROVISIONING_H_ */
```

## src/ikg_check.c
```c
/*
 * Copyright (c) 2025 Nordic Semiconductor ASA
 *
 * SPDX-License-Identifier: LicenseRef-Nordic-5-Clause
 */

/**
 * Step 2 — Validate that no IKG seed or KeyRAM random data is already present.
 *
 * Check strategy (from a TF-M non-secure context):
 *
 * IKG seed presence:
 *   The IKG seed is stored in KMU with CRACEN_KMU_KEY_USAGE_SCHEME_SEED.
 *   When the seed is present, CRACEN can derive the Initial Attestation Key
 *   (IAK, ID = CRACEN_BUILTIN_IDENTITY_KEY_ID = 0x7FFFC001).
 *   We attempt psa_export_public_key() on the IAK:
 *     - PSA_SUCCESS                → seed IS present (error — must suspend).
 *     - PSA_ERROR_DOES_NOT_EXIST   → seed not present (good).
 *     - Other error                → inconclusive; logged and treated as error.
 *
 * KeyRAM random slots (PROTECTED_RAM_INVALIDATION_DATA_SLOT1 = 248,
 *                      PROTECTED_RAM_INVALIDATION_DATA_SLOT2 = 249):
 *   We attempt psa_get_key_attributes() on the PSA key ID that maps to each
 *   slot:
 *     - PSA_SUCCESS                → slot occupied (error — must suspend).
 *     - PSA_ERROR_INVALID_HANDLE   → slot empty (good).
 *     - PSA_ERROR_DOES_NOT_EXIST   → slot empty (good).
 */

#include "ikg_check.h"
#include "mfg_log.h"
#include "recovery.h"

#include <psa/crypto.h>
#include <cracen_psa_kmu.h>
#include <cracen_psa_key_ids.h>

/* ---------------------------------------------------------------------------
 * IKG seed presence check via IAK derivability
 * ---------------------------------------------------------------------------
 */
static void check_ikg_seed_slots(void)
{
	MFG_LOG_INF("Verifying KMU IKG seed slots...");

	uint8_t pub_key_buf[32]; /* Ed25519 public key, 32 bytes */
	size_t  pub_key_len = 0;

	mbedtls_svc_key_id_t iak_id =
		mbedtls_svc_key_id_make(0, CRACEN_BUILTIN_IDENTITY_KEY_ID);

	psa_status_t status = psa_export_public_key(iak_id,
						    pub_key_buf, sizeof(pub_key_buf),
						    &pub_key_len);

	if (status == PSA_ERROR_DOES_NOT_EXIST || status == PSA_ERROR_INVALID_HANDLE) {
		MFG_LOG_INF(" OK (empty)\n");
		return;
	}

	if (status == PSA_SUCCESS) {
		MFG_LOG_INF(" FAIL (not empty)\n");
		MFG_LOG_ERR("\nSeems IKG seed is already provisioned. Secrecy and entropy level\n");
		MFG_LOG_ERR("of that data cannot be trusted.\n");
		recovery_suspend(false);
	}

	/* Any other error is inconclusive — treat as failure for safety. */
	MFG_LOG_INF(" FAIL (psa_export_public_key returned %d — inconclusive)\n", status);
	MFG_LOG_ERR("\nCould not determine IKG seed slot state. Halting for safety.\n");
	recovery_suspend(false);
}

/* ---------------------------------------------------------------------------
 * KeyRAM random slot presence check
 *
 * Slot numbers are defined in cracen_kmu.h:
 *   PROTECTED_RAM_INVALIDATION_DATA_SLOT1 = 248
 *   PROTECTED_RAM_INVALIDATION_DATA_SLOT2 = 249
 * ---------------------------------------------------------------------------
 */
static void check_one_keyram_slot(int slot_id)
{
	MFG_LOG_INF("Verifying KMU KeyRAM random slot %d...", slot_id);

	psa_key_id_t key_id = PSA_KEY_HANDLE_FROM_CRACEN_KMU_SLOT(
		CRACEN_KMU_KEY_USAGE_SCHEME_PROTECTED, slot_id);

	mbedtls_svc_key_id_t svc_key_id = mbedtls_svc_key_id_make(0, key_id);

	psa_key_attributes_t attr = PSA_KEY_ATTRIBUTES_INIT;
	psa_status_t status = psa_get_key_attributes(svc_key_id, &attr);

	psa_reset_key_attributes(&attr);

	if (status == PSA_ERROR_INVALID_HANDLE || status == PSA_ERROR_DOES_NOT_EXIST) {
		MFG_LOG_INF(" OK (empty)\n");
		return;
	}

	if (status == PSA_SUCCESS) {
		MFG_LOG_INF(" FAIL (not empty)\n");
		MFG_LOG_ERR("\nSeems KeyRAM random (slot %d) is already provisioned.\n", slot_id);
		MFG_LOG_ERR("Secrecy and entropy level of that data cannot be trusted.\n");
		recovery_suspend(false);
	}

	MFG_LOG_INF(" FAIL (psa_get_key_attributes returned %d — inconclusive)\n", status);
	MFG_LOG_ERR("\nCould not determine KeyRAM random slot %d state. Halting for safety.\n",
		    slot_id);
	recovery_suspend(false);
}

/* ---------------------------------------------------------------------------
 * Step 2 entry point
 * ---------------------------------------------------------------------------
 */
void ikg_step2_check_empty(void)
{
	MFG_LOG_STEP("Checking IKG seed presence");

	check_ikg_seed_slots();

	check_one_keyram_slot(PROTECTED_RAM_INVALIDATION_DATA_SLOT1);
	check_one_keyram_slot(PROTECTED_RAM_INVALIDATION_DATA_SLOT2);
}
```

## src/ikg_check.h
```c
/*
 * Copyright (c) 2025 Nordic Semiconductor ASA
 *
 * SPDX-License-Identifier: LicenseRef-Nordic-5-Clause
 */

/**
 * @file ikg_check.h
 *
 * Step 2 — Validate that no IKG seed or KeyRAM random data is already
 * present in KMU in LCS = 'Manufacturing and Test'.
 *
 * A pre-existing seed would indicate either a leftover from previous
 * activity on the device or an intentional malicious action. Either case
 * is a serious security flaw and manufacturing must halt.
 */

#ifndef IKG_CHECK_H_
#define IKG_CHECK_H_

/**
 * @brief Step 2 — Check that IKG seed and KeyRAM random slots are empty.
 *
 * Only call this function when LCS = 'Manufacturing and Test'. It verifies:
 *   1. The IKG seed KMU slots (used by CRACEN's internal key generator) are
 *      empty — confirmed indirectly by attempting to use the IAK and
 *      expecting failure.
 *   2. The KeyRAM random invalidation slots (248, 249) are empty.
 *
 * Suspends execution if either check finds pre-existing data.
 */
void ikg_step2_check_empty(void);

#endif /* IKG_CHECK_H_ */
```

## src/image_validation.c
```c
/*
 * Copyright (c) 2025 Nordic Semiconductor ASA
 *
 * SPDX-License-Identifier: LicenseRef-Nordic-5-Clause
 */

/**
 * Step 3 — Image digest validation.
 *
 * Sub-image accessibility from a TF-M non-secure application:
 *
 * BL1:
 *   Resides in the Secure flash region. The NS application cannot read it
 *   directly. Validation requires either:
 *     a) A TF-M platform service that hashes a given Secure flash range and
 *        returns the digest to the NS caller.
 *     b) Having BL1 validate itself and expose the result via a platform call.
 *   TODO: Implement one of the options above. Currently stubbed.
 *
 * BL2 (MCUboot), slot A and slot B:
 *   MCUboot also resides in Secure flash (boot_partition at offset 0x000000).
 *   Same limitation as BL1 applies.
 *   TODO: Implement a TF-M platform service for Secure flash hashing.
 *
 * Manufacturing application (self-validation):
 *   The manufacturing app is an MCUboot-compatible image stored in the NS
 *   flash partition (slot0_ns_partition). Its SHA-256 hash is stored in the
 *   MCUboot image TLV (Type-Length-Value trailer). The NS app can:
 *     1. Read the MCUboot header to find the image size.
 *     2. Hash the image body using psa_hash_compute().
 *     3. Read the expected hash from the TLV and compare.
 *   This is possible because the NS app has read access to its own flash
 *   partition via the FLASH_MAP API.
 *   TODO: Implement TLV parsing and self-hash. Currently stubbed due to
 *   dependency on MCUboot TLV layout headers.
 *
 * Application candidate:
 *   Stored in slot1_ns_partition (NS flash, readable by the NS app). The
 *   expected digest is injected at build time via -DMFG_APP_CANDIDATE_DIGEST.
 *   TODO: Implement flash-map read and PSA hash comparison.
 */

#include "image_validation.h"
#include "mfg_log.h"
#include "recovery.h"

#include <psa/crypto.h>
#include <image_digests.h>

/* ---------------------------------------------------------------------------
 * Digest comparison helper
 * ---------------------------------------------------------------------------
 */
static bool digests_equal(const uint8_t *a, const uint8_t *b, size_t len)
{
	/* Constant-time compare to avoid timing side-channels. */
	uint8_t diff = 0;

	for (size_t i = 0; i < len; i++) {
		diff |= a[i] ^ b[i];
	}
	return diff == 0;
}

/* ---------------------------------------------------------------------------
 * BL1 validation (stub — requires Secure flash access via platform service)
 * ---------------------------------------------------------------------------
 */
static void validate_bl1(void)
{
	MFG_LOG_INF("Validating Bootloader 1...");

	if (mfg_digest_is_zero(mfg_bl1_expected_digest)) {
		MFG_LOG_INF(" SKIP (no expected digest provided at build time)\n");
		MFG_LOG_INF("  Provide -DMFG_BL1_DIGEST=<sha256hex> to enable BL1 validation.\n");
		return;
	}

	/*
	 * TODO: Call a TF-M platform service to hash the BL1 flash region.
	 *
	 * Pseudocode:
	 *   uint8_t actual[MFG_DIGEST_LEN];
	 *   int err = platform_svc_hash_secure_region(BL1_START, BL1_SIZE, actual);
	 *   if (err != 0 || !digests_equal(actual, mfg_bl1_expected_digest, MFG_DIGEST_LEN)) {
	 *       MFG_LOG_INF(" FAIL (incorrect digest)\n");
	 *       recovery_suspend(false);
	 *   }
	 *   MFG_LOG_INF(" OK\n");
	 */
	MFG_LOG_INF(" SKIP (BL1 in Secure flash — platform service not yet implemented)\n");
}

/* ---------------------------------------------------------------------------
 * BL2 (MCUboot) slot A validation (stub — requires Secure flash access)
 * ---------------------------------------------------------------------------
 */
static void validate_bl2_slot_a(void)
{
	MFG_LOG_INF("Validating Bootloader 2, slot A...");

	if (mfg_digest_is_zero(mfg_bl2_slot_a_expected_digest)) {
		MFG_LOG_INF(" SKIP (no expected digest provided at build time)\n");
		return;
	}

	/* TODO: Same as BL1 — requires Secure flash hashing platform service. */
	MFG_LOG_INF(" SKIP (BL2 in Secure flash — platform service not yet implemented)\n");
}

/* ---------------------------------------------------------------------------
 * BL2 (MCUboot) slot B validation (stub — requires Secure flash access)
 * ---------------------------------------------------------------------------
 */
static void validate_bl2_slot_b(void)
{
	MFG_LOG_INF("Validating Bootloader 2, slot B...");

	if (mfg_digest_is_zero(mfg_bl2_slot_b_expected_digest)) {
		MFG_LOG_INF(" SKIP (no expected digest provided at build time)\n");
		return;
	}

	/* TODO: Same as BL1 — requires Secure flash hashing platform service. */
	MFG_LOG_INF(" SKIP (BL2 in Secure flash — platform service not yet implemented)\n");
}

/* ---------------------------------------------------------------------------
 * Manufacturing application self-validation
 *
 * The manufacturing app is an MCUboot-compatible NS image. MCUboot signs it
 * and stores the SHA-256 hash in the image TLV. At runtime the app can:
 *   1. Read the MCUboot image header at its own load address to find image_size.
 *   2. Hash bytes [header_size .. header_size + image_size) with PSA SHA-256.
 *   3. Parse the TLV area (after the image body) for the SHA256 TLV entry.
 *   4. Compare the computed hash with the stored hash.
 *
 * This avoids the chicken-and-egg problem because:
 *   - The hash is computed over the image body only (not the TLV).
 *   - The TLV entry containing the expected hash is outside the hashed area.
 *   - imgtool places the hash in the TLV using this exact convention.
 *
 * TODO: Implement TLV parsing. Requires either:
 *   a) Including MCUboot's bootutil/image.h header in the NS application.
 *   b) Implementing a minimal TLV parser for the fields needed.
 * ---------------------------------------------------------------------------
 */
static void validate_manufacturing_app(void)
{
	MFG_LOG_INF("Validating Manufacturing application (self-check)...");

	/*
	 * TODO: Implement self-validation using the MCUboot TLV hash.
	 *
	 * Pseudocode:
	 *
	 *   const struct image_header *hdr =
	 *       (const struct image_header *)PM_MCUBOOT_PRIMARY_NS_ADDRESS;
	 *
	 *   uint8_t computed[PSA_HASH_LENGTH(PSA_ALG_SHA_256)];
	 *   size_t  computed_len;
	 *   const uint8_t *image_body = (uint8_t *)hdr + hdr->ih_hdr_size;
	 *
	 *   psa_status_t status = psa_hash_compute(
	 *       PSA_ALG_SHA_256,
	 *       image_body, hdr->ih_img_size,
	 *       computed, sizeof(computed), &computed_len);
	 *
	 *   // Parse TLV for IMAGE_TLV_SHA256 entry and compare.
	 */
	MFG_LOG_INF(" SKIP (TLV parser not yet implemented)\n");
}

/* ---------------------------------------------------------------------------
 * Application candidate validation
 * ---------------------------------------------------------------------------
 */
static void validate_app_candidate(void)
{
	MFG_LOG_INF("Validating Application candidate...");

	if (mfg_digest_is_zero(mfg_app_candidate_expected_digest)) {
		MFG_LOG_INF(" SKIP (no expected digest provided at build time)\n");
		MFG_LOG_INF("  Provide -DMFG_APP_CANDIDATE_DIGEST=<sha256hex> to enable.\n");
		return;
	}

	/*
	 * TODO: Read the application candidate from flash (slot1_ns_partition)
	 * and hash it, then compare against mfg_app_candidate_expected_digest.
	 *
	 * The NS app has read access to its own NS flash partition via
	 * the Zephyr FLASH_MAP / FIXED_PARTITION APIs.
	 *
	 * Pseudocode:
	 *   const struct flash_area *fa;
	 *   flash_area_open(FIXED_PARTITION_ID(slot1_partition), &fa);
	 *
	 *   uint8_t computed[MFG_DIGEST_LEN];
	 *   size_t  computed_len;
	 *   // Read candidate image and hash it with psa_hash_compute().
	 *   // Compare with mfg_app_candidate_expected_digest.
	 */
	MFG_LOG_INF(" SKIP (flash-map read not yet implemented)\n");
}

/* ---------------------------------------------------------------------------
 * Step 3 entry point
 * ---------------------------------------------------------------------------
 */
void image_step3_validate_all(void)
{
	MFG_LOG_STEP("Validating images");

	validate_bl1();
	validate_bl2_slot_a();
	validate_bl2_slot_b();
	validate_manufacturing_app();
	validate_app_candidate();
}
```

## src/image_validation.h
```c
/*
 * Copyright (c) 2025 Nordic Semiconductor ASA
 *
 * SPDX-License-Identifier: LicenseRef-Nordic-5-Clause
 */

/**
 * @file image_validation.h
 *
 * Step 3 — Validate digests of all sub-images in the initial image.
 */

#ifndef IMAGE_VALIDATION_H_
#define IMAGE_VALIDATION_H_

/**
 * @brief Step 3 — Validate all sub-image digests.
 *
 * Checks SHA-256 digests of:
 *   - BL1 (expected digest injected at build time via -DMFG_BL1_DIGEST=...)
 *   - BL2, slot A (expected digest injected at build time)
 *   - BL2, slot B (expected digest injected at build time)
 *   - Manufacturing application (reads its own MCUboot TLV at runtime)
 *   - Application candidate (expected digest injected at build time)
 *
 * Suspends execution if any verification fails.
 *
 * @note BL1 and BL2 reside in Secure flash and cannot be read directly from
 *       a TF-M non-secure application. Their validation is currently stubbed.
 *       See image_validation.c for integration details.
 */
void image_step3_validate_all(void);

#endif /* IMAGE_VALIDATION_H_ */
```

## src/key_provisioning.h
```c
/*
 * Copyright (c) 2025 Nordic Semiconductor ASA
 *
 * SPDX-License-Identifier: LicenseRef-Nordic-5-Clause
 */

/**
 * @file key_provisioning.h
 *
 * Steps 4 and 12 — Provision and verify secure-boot / ADAC public keys,
 * and revoke the manufacturing application authentication key.
 */

#ifndef KEY_PROVISIONING_H_
#define KEY_PROVISIONING_H_

/**
 * @brief Step 4 — Provision and verify all secure-boot and ADAC keys.
 *
 * For each key defined in the keys/ directory:
 *   1. Validates PEM format and detects private keys.
 *   2. Warns if the key is the known placeholder from this sample.
 *   3. Checks whether the key is already in the KMU slot.
 *   4. If not provisioned, writes the key to KMU.
 *   5. Verifies the key by performing a signature check using a pre-built
 *      verification message from keys/key_verification_msgs/.
 *
 * Suspends execution on any error that cannot be recovered from.
 */
void key_step4_provision_all(void);

/**
 * @brief Step 12 — Revoke the manufacturing application authentication key.
 *
 * Destroys the key held in KMU slot CONFIG_MFG_APP_KEY_KMU_SLOT.
 * After this call the manufacturing application's signing key is revoked and
 * the device will reject any future manufacturing image signed with that key
 * (provided the slot used LIB_KMU_REV_POLICY_ROTATING or REVOKABLE policy).
 */
void key_step12_revoke_mfg_key(void);

#endif /* KEY_PROVISIONING_H_ */
```
