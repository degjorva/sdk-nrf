## CMakeLists.txt
```
#
# Copyright (c) 2025 Nordic Semiconductor ASA
#
# SPDX-License-Identifier: LicenseRef-Nordic-5-Clause
#

cmake_minimum_required(VERSION 3.20.0)

# Configure TF-M to use local PSA-ADAC repository
set(TFM_EXTRA_CONFIG_PATH "${CMAKE_CURRENT_LIST_DIR}/tfm_config.cmake" CACHE PATH "")

find_package(Zephyr REQUIRED HINTS $ENV{ZEPHYR_BASE})

project(adac)

target_sources(app PRIVATE src/main.c)
```

## sample.yaml
```
sample:
  name: ADAC TF-M Sample
  description: Demonstrates ADAC (Authenticated Debug Access Control) with TF-M
tests:
  sample.tfm.adac:
    sysbuild: true
    platform_allow:
      - nrf54l15dk/nrf54l15/cpuapp/ns
    tags: tfm adac ci_samples_tfm
```

## prj.conf
```kconfig
#
# Copyright (c) 2025 Nordic Semiconductor ASA
#
# SPDX-License-Identifier: LicenseRef-Nordic-5-Clause
#

CONFIG_TFM_PROFILE_TYPE_NOT_SET=y
CONFIG_TFM_PARTITION_LOG_LEVEL_DEBUG=y

# ADAC partition
CONFIG_TFM_PARTITION_ADAC=y
CONFIG_TFM_PLATFORM_PSA_ADAC_SECURE_DEBUG=y

# Multi-generation key support (slots 207-214)
CONFIG_TFM_ADAC_ROTPK_KMU_SLOT_BASE=207
CONFIG_TFM_ADAC_AUTH_KEY_GEN=0
CONFIG_TFM_ADAC_AUTO_REVOKE=y

# Ed25519ph (prehashed) algorithm support for ADAC
CONFIG_PSA_WANT_ECC_TWISTED_EDWARDS_255=y
CONFIG_PSA_WANT_KEY_TYPE_ECC_KEY_PAIR_IMPORT=y
CONFIG_PSA_WANT_ALG_SHA_512=y
CONFIG_PSA_WANT_ALG_ED25519PH=y
# Pure EdDSA is required for Ed25519 public key handling in CRACEN driver
CONFIG_PSA_WANT_ALG_PURE_EDDSA=y

# Allow user to control APPROTECT
CONFIG_NRF_APPROTECT_USER_HANDLING=y
CONFIG_NRF_SECURE_APPROTECT_USER_HANDLING=y
```

## src/main.c
```c
/*
 * Copyright (c) 2025 Nordic Semiconductor ASA.
 *
 * SPDX-License-Identifier: LicenseRef-Nordic-5-Clause
 */

#include <zephyr/kernel.h>
#include <zephyr/sys/printk.h>
#include <stdio.h>

int main(void)
{
	printk("Attach the debugger.\n");

	while (1) {
		k_sleep(K_MSEC(1000)); /* You should hit this with your debugger. */

		/* When you are here, you should be able to hit breakpoints in your bootloader.
		 *
		 * To do this, you need to run the following command in the debugger:
		 * - `monitor reset halt` (in gdb)
		 * - `exec monitor reset halt` (in gdb with VSCode)
		 */
	}

	return 0;
}
```
